## meta-mytutorial/conf/layer.conf
```bitbake
# We have a conf and classes directory, add to BBPATH
BBPATH .= ":${LAYERDIR}"

# We have recipes-* directories, add to BBFILES
BBFILES += "${LAYERDIR}/recipes-*/*/*.bb \
            ${LAYERDIR}/recipes-*/*/*.bbappend"

BBFILE_COLLECTIONS += "mytutorial"
BBFILE_PATTERN_mytutorial = "^${LAYERDIR}/"
BBFILE_PRIORITY_mytutorial = "5"
LAYERVERSION_mytutorial = "1"
LAYERSERIES_COMPAT_mytutorial = "nanbield"
```
